## sdkconfig.defaults
```kconfig
CONFIG_GITHUB_OWNER="Fishwaldo"
CONFIG_GITHUB_REPO="fanctrl"
CONFIG_PARTITION_TABLE_CUSTOM=y
CONFIG_PARTITION_TABLE_CUSTOM_FILENAME="custompartitions.csv"
CONFIG_PARTITION_TABLE_FILENAME="custompartitions.csv"
CONFIG_ESPTOOLPY_FLASHSIZE_4MB=y
CONFIG_ESP32_SPIRAM_SUPPORT=y
CONFIG_FREERTOS_GENERATE_RUN_TIME_STATS=y
```

## sdkconfig.defaults.esp32s3
```kconfig
CONFIG_IDF_TARGET="esp32s3"
CONFIG_IDF_TARGET_ESP32S3=y
CONFIG_IDF_FIRMWARE_CHIP_ID=0x0009

CONFIG_ESPTOOLPY_FLASHFREQ_80M=y
CONFIG_ESPTOOLPY_FLASHFREQ="80m"
CONFIG_ESPTOOLPY_FLASHSIZE_16MB=y
CONFIG_ESPTOOLPY_FLASHSIZE="16MB"

CONFIG_PARTITION_TABLE_CUSTOM_FILENAME="custompartitions-esp32s3.csv"
CONFIG_PARTITION_TABLE_FILENAME="custompartitions-esp32s3.csv"

#
# Cache config
#
# CONFIG_ESP32S3_INSTRUCTION_CACHE_16KB is not set
CONFIG_ESP32S3_INSTRUCTION_CACHE_32KB=y
CONFIG_ESP32S3_INSTRUCTION_CACHE_SIZE=0x8000
# CONFIG_ESP32S3_INSTRUCTION_CACHE_4WAYS is not set
CONFIG_ESP32S3_INSTRUCTION_CACHE_8WAYS=y
CONFIG_ESP32S3_ICACHE_ASSOCIATED_WAYS=8
CONFIG_ESP32S3_INSTRUCTION_CACHE_LINE_32B=y
CONFIG_ESP32S3_INSTRUCTION_CACHE_LINE_SIZE=32
# CONFIG_ESP32S3_INSTRUCTION_CACHE_WRAP is not set
# CONFIG_ESP32S3_DATA_CACHE_16KB is not set
# CONFIG_ESP32S3_DATA_CACHE_32KB is not set
CONFIG_ESP32S3_DATA_CACHE_64KB=y
CONFIG_ESP32S3_DATA_CACHE_SIZE=0x10000
# CONFIG_ESP32S3_DATA_CACHE_4WAYS is not set
CONFIG_ESP32S3_DATA_CACHE_8WAYS=y
CONFIG_ESP32S3_DCACHE_ASSOCIATED_WAYS=8
CONFIG_ESP32S3_DATA_CACHE_LINE_32B=y
# CONFIG_ESP32S3_DATA_CACHE_LINE_64B is not set
CONFIG_ESP32S3_DATA_CACHE_LINE_SIZE=32
# CONFIG_ESP32S3_DATA_CACHE_WRAP is not set
# end of Cache config


CONFIG_ESP32S3_SPIRAM_SUPPORT=y

#
# SPI RAM config
#
# CONFIG_SPIRAM_MODE_QUAD is not set
CONFIG_SPIRAM_MODE_OCT=y
CONFIG_SPIRAM_TYPE_AUTO=y
# CONFIG_SPIRAM_TYPE_ESPPSRAM64 is not set
CONFIG_SPIRAM_SIZE=-1

#
# PSRAM Clock and CS IO for ESP32S3
#
CONFIG_DEFAULT_PSRAM_CLK_IO=30
CONFIG_DEFAULT_PSRAM_CS_IO=26
# end of PSRAM Clock and CS IO for ESP32S3

# CONFIG_SPIRAM_FETCH_INSTRUCTIONS is not set
# CONFIG_SPIRAM_RODATA is not set
# CONFIG_SPIRAM_ALLOW_STACK_EXTERNAL_MEMORY is not set
CONFIG_SPIRAM_SPEED_80M=y
# CONFIG_SPIRAM_SPEED_40M is not set
CONFIG_SPIRAM=y
CONFIG_SPIRAM_BOOT_INIT=y
CONFIG_SPIRAM_IGNORE_NOTFOUND=y
# CONFIG_SPIRAM_USE_MEMMAP is not set
# CONFIG_SPIRAM_USE_CAPS_ALLOC is not set
CONFIG_SPIRAM_USE_MALLOC=y
CONFIG_SPIRAM_MEMTEST=y
CONFIG_SPIRAM_MALLOC_ALWAYSINTERNAL=16384
# CONFIG_SPIRAM_TRY_ALLOCATE_WIFI_LWIP is not set
CONFIG_SPIRAM_MALLOC_RESERVE_INTERNAL=32768
# end of SPI RAM config
```

## src/Kconfig.projbuild
```kconfig
menu "Fan Controller Configuration"

    config FANCTRL_HOSTNAME
        string "Hostname"
        default "FanCtlr"
        help
            This sets the Hostname

    choice FANCTRL_PROV_TRANSPORT
        bool "Provisioning Transport"
        default FANCTRL_PROV_TRANSPORT_SOFTAP if IDF_TARGET_ESP32S2
        default FANCTRL_PROV_TRANSPORT_BLE
        help
            Wi-Fi provisioning component offers both, SoftAP and BLE transports. Choose any one.

        config FANCTRL_PROV_TRANSPORT_BLE
            bool "BLE"
            select BT_ENABLED
            depends on !IDF_TARGET_ESP32S2
        config FANCTRL_PROV_TRANSPORT_SOFTAP
            bool "Soft AP"
    endchoice

    choice FANCTRL_PROV_SECURITY_VERSION
        bool "Protocomm security version"
        default FANCTRL_PROV_SECURITY_VERSION_1
        help
            Wi-Fi provisioning component offers 3 security versions.
            The example offers a choice between security version 1 and 2.

        config FANCTRL_PROV_SECURITY_VERSION_1
            bool "Security version 1"
            select ESP_PROTOCOMM_SUPPORT_SECURITY_VERSION_1

        config FANCTRL_PROV_SECURITY_VERSION_2
            bool "Security version 2"
            select ESP_PROTOCOMM_SUPPORT_SECURITY_VERSION_2
    endchoice

    choice FANCTRL_PROV_MODE
        bool "Security version 2 mode"
        depends on FANCTRL_PROV_SECURITY_VERSION_2
        default FANCTRL_PROV_SEC2_DEV_MODE

        config FANCTRL_PROV_SEC2_DEV_MODE
            bool "Security version 2 development mode"
            depends on FANCTRL_PROV_SECURITY_VERSION_2
            help
                This enables the development mode for
                security version 2.
                Please note that this mode is NOT recommended for production purpose.

        config FANCTRL_PROV_SEC2_PROD_MODE
            bool "Security version 2 production mode"
            depends on FANCTRL_PROV_SECURITY_VERSION_2
            help
                This enables the production mode for
                security version 2.
    endchoice

    config FANCTRL_PROV_TRANSPORT
        int
        default 1 if FANCTRL_PROV_TRANSPORT_BLE
        default 2 if FANCTRL_PROV_TRANSPORT_SOFTAP

    config FANCTRL_RESET_PROVISIONED
        bool
        default n
        prompt "Reset provisioned status of the device"
        help
            This erases the NVS to reset provisioned status of the device on every reboot.
            Provisioned status is determined by the Wi-Fi STA configuration, saved on the NVS.

    config FANCTRL_RESET_PROV_MGR_ON_FAILURE
        bool
        default y
        prompt "Reset provisioned credentials and state machine after session failure"
        help
            Enable reseting provisioned credentials and state machine after session failure.
            This will restart the provisioning service after retries are exhausted.

    config FANCTRL_PROV_MGR_MAX_RETRY_CNT
        int
        default 5
        prompt "Max retries before reseting provisioning state machine"
        depends on FANCTRL_RESET_PROV_MGR_ON_FAILURE
        help
            Set the Maximum retry to avoid reconnecting to an inexistent AP or if credentials
            are misconfigured. Provisioned credentials are erased and internal state machine
            is reset after this threshold is reached.

    config FANCTRL_PROV_USING_BLUEDROID
        bool
        depends on (BT_BLUEDROID_ENABLED && (IDF_TARGET_ESP32C3 || IDF_TARGET_ESP32S3))
        select BT_BLE_42_FEATURES_SUPPORTED
        default y
        help
            This enables BLE 4.2 features for Bluedroid.

endmenu

menu "Github OTA Configuration"

    config MAX_FILENAME_LEN
        int "The Max Size Of Filenames"
        default 64
        help
            The Maximum Size of Filenames stored at the Repository

    config MAX_URL_LEN
        int "The Max Size Of URLs"
        default 128
        help
            The Maximum Size of URl's to download Firmware Files
    
    config GITHUB_HOSTNAME
        string "The Hostname of the Github Repository"
        default "api.github.com"
        help
            The Hostname of the Github API Server

    config GITHUB_OWNER
        string "The Owner of the Github Repository"
        default "Fishwaldo"
        help
            The Owner of the Github Repository

    config GITHUB_REPO
        string "The Repository of the Github Repository"
        default "esp_ghota"
        help
            The Repository of the Github Repository

endmenu
```
